## linux_module/2013-7-17/Kconfig
```kconfig
#
# TEST driver  configuration
#
menu "TEST Driver"
comment "TEST Driver"

config TEST_KOBJ
	tristate "TEST_KOBJ"
	
config TEST_KSET
	tristate "TEST_KSET"
	
endmenu
```

## linux_module/2013-7-18/Kconfig
```kconfig
#
# TEST driver  configuration
#
menu "TEST Driver"
comment "TEST Driver"

config TEST_KOBJ
	tristate "TEST_KOBJ"
	
config TEST_KSET
	tristate "TEST_KSET"
	
config TEST_BUS_BASIC
	tristate "TEST_BUS_BASIC"
	
endmenu
```

## linux_module/Kconfig
```kconfig
#
# TEST driver  configuration
#
menu "TEST Driver"
comment "TEST Driver"

config TEST_KOBJ
	tristate "TEST support"
	
config TEST_KSET
	tristate "TEST user-space interface"
	
endmenu
```
